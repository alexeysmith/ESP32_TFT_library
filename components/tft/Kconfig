## components/tft/Kconfig
```kconfig
menu "ESP32 TFT Library"

    config TFT_RGB_BGR
        hex "TFT_RGB_BGR (0X00 FOR DISPLAYS WITH RGB MATRIX)"
        default 0x00
    
    config TFT_PIN_NUM_MISO
        int "MISO Pin"
        range 1 100
        default 32
    config TFT_PIN_NUM_CLK
        int "CLK Pin (SCL)"
        range 1 100
        default 25
    config TFT_PIN_NUM_MOSI
        int "MOSI Pin (SDA)"
        range 1 100
        default 12
    config TFT_PIN_NUM_DC
        int "DC Pin"
        range 1 100
        default 27
    config TFT_PIN_NUM_RST
        int "RESET Pin (RES)"
        range 1 100
        default 26
    config TFT_WIDTH
        int "Screen Width"
        range 1 9000
        default 240
    config TFT_HEIGHT
        int "Screen Height"
        range 1 9000
        default 240

endmenu
```

## sdkconfig.defaults
```kconfig
CONFIG_FREERTOS_HZ=1000
CONFIG_TASK_WDT_TIMEOUT_S=20

CONFIG_TFT_DISP_COLOR_BITS_24=0x66
#CONFIG_TFT_DISP_COLOR_BITS_16=0x55

CONFIG_TFT_INVERT_ROTATION=0
CONFIG_TFT_INVERT_ROTATION1=1

CONFIG_TFT_RGB_BGR=0x08

CONFIG_TFT_PIN_NUM_MISO=32
CONFIG_TFT_PIN_NUM_MOSI=12
CONFIG_TFT_PIN_NUM_CLK=25
CONFIG_TFT_PIN_NUM_CS=33
CONFIG_TFT_PIN_NUM_DC=27
CONFIG_TFT_PIN_NUM_TCS=25

CONFIG_TFT_PIN_NUM_RST=26

CONFIG_TFT_PIN_NUM_BCKL=17
CONFIG_TFT_PIN_BCKL_ON=0
CONFIG_TFT_PIN_BCKL_OFF=1

CONFIG_TFT_USE_TOUCH=TOUCH_TYPE_NONE

CONFIG_TFT_DEFAULT_TFT_DISPLAY_WIDTH=240
CONFIG_TFT_DEFAULT_TFT_DISPLAY_HEIGHT=240

CONFIG_TFT_DEFAULT_GAMMA_CURVE=0
CONFIG_TFT_DEFAULT_SPI_CLOCK=8000000
CONFIG_TFT_DEFAULT_DISP_TYPE=DISP_TYPE_ST7789V
```
